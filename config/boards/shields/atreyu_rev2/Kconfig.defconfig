## config/boards/shields/atreyu_rev2/Kconfig.defconfig
```kconfig
# Copyright (c) 2020 The ZMK Contributors
# SPDX-License-Identifier: MIT

if SHIELD_ATREYU_REV2

config ZMK_KEYBOARD_NAME
    default "joshwu_Atreyu"

endif

if ZMK_DISPLAY

config I2C
    default y

config SSD1309
    default y

endif
```

## config/west.yml
```yaml
manifest:
  remotes:
    - name: zmkfirmware
      url-base: https://github.com/zmkfirmware
    # support nice_oled and nice_epaper
    - name: mctechnology17
      url-base: https://github.com/mctechnology17
  projects:
    - name: zmk
      remote: zmkfirmware
      revision: v0.3.0
      import: app/west.yml

  self:
    path: config
```
