/ {
   
	oled: ssd1306@3c {
        // 分辨率修改
    width = <128>;
    height = <64>;
    compatible = "sinowealth,sh1106";   //1.30
    segment-offset = <2>;   //1.30
		multiplex-ratio = <63>; //128*64      
		reg = <0x3c>;
		label = "Dongle_DISPLAY";
		page-offset = <0>;
		display-offset = <0>;
		segment-remap;
		com-invdir;
    inversion-on;   // 翻转颜色
		prechargep = <0x22>;
    };
};
