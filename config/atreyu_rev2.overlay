/ {
    chosen {
        zmk,display = &sharp_lcd; /* 指向新的节点标签 */
    };
};

&spi0 {
    status = "okay";
    sharp_lcd: sharp-ls013b7dh03@0 {
        compatible = "sharp,ls013b7dh03"; /* 必须与 .conf 中的驱动匹配 */
        reg = <0>;
        spi-max-frequency = <1000000>;
        cs-gpios = <&gpio1 1 GPIO_ACTIVE_HIGH>;
        width = <128>;
        height = <128>;
        rotation = <0>;
        status = "okay";
    };
};
